/*
 * ESB split-transport radio addresses (badjeff/zmk-feature-split-esb).
 * Must be identical on both halves - arbitrary values, fine for a single
 * personal board (README's own example values).
 */
/ {
    esb_split {
        compatible = "zmk,esb-split";
        base-addr-0 = <0xE7 0xE7 0xE7 0xE7>;
        base-addr-1 = <0xC2 0xC2 0xC2 0xC2>;
        addr-prefix = <0xE7 0xC2 0xC3 0xC4 0xC5 0xC6 0xC7 0xC8>;
    };
};
