## config/Kconfig
```kconfig
menu "Delta Omega User Behaviors"

config ZMK_RAPID_FIRE_MIN_INTERVAL_MS
    int "Rapid-fire minimum interval in milliseconds"
    default 20
    range 5 1000

config ZMK_RAPID_FIRE_MAX_INTERVAL_MS
    int "Rapid-fire maximum interval in milliseconds"
    default 26
    range 5 1000

config ZMK_RAPID_FIRE_TAP_MS
    int "Rapid-fire virtual tap duration in milliseconds"
    default 2
    range 1 100
    help
      A 1ms virtual press is only as wide as a single USB 1000Hz polling
      frame, leaving no margin for the host to reliably observe it. 2ms
      costs nothing against the 20-26ms interval (repeat rate is set by
      the interval, not this) but gives a full frame of headroom.

config ZMK_DEBOUNCE_TAP_COOLDOWN_MS
    int "Debounce-tap: minimum gap between fires on the same position"
    default 30
    range 5 200
    help
      A repeat trigger on the same position within this window of the
      last one is treated as switch chatter and ignored.

config ZMK_DEBOUNCE_TAP_MS
    int "Debounce-tap: virtual tap duration in milliseconds"
    default 5
    range 1 100

config ZMK_SPACE_HT_TAPPING_TERM_MS
    int "Space hold-tap: tapping term in milliseconds"
    default 190
    range 50 500

config ZMK_SPACE_HT_RELEASE_GRACE_MS
    int "Space hold-tap: grace period after release before deactivating the hold layer"
    default 40
    range 5 200
    help
      If the key is pressed again within this window after releasing
      while the hold layer is active, the release is treated as switch
      chatter and the hold continues uninterrupted.

config ZMK_GAMING_CMD_WINDOW_MS
    int "Gaming command state machine: window to remember a pending Down-arrow sequence"
    default 220
    range 50 2000
    help
      How long the internal state machine remembers a pending down-arrow
      -> down-arrow sequence (Command A/B on the Gaming layer) before
      auto-resetting to idle. This only bounds how long the *state* is
      remembered - every physical press still outputs its HID key
      immediately, nothing is buffered or delayed.

config ZMK_G_LATCH_MAX_HOLD_MS
    int "G latch: maximum total HID hold duration in milliseconds"
    default 180
    range 50 2000
    help
      Experimental rapid-fire alternative for a single key (glatch
      branch only). G's HID stays down after physical release (latched)
      until a direction key (LEFT/RIGHT) ends it or this many ms have
      elapsed since the *physical press* - whichever comes first. Not an
      extra delay added after release; it's a cap on total HID hold time
      from press. A/B candidates: 150/180/220.

endmenu
```

## config/dts/bindings/behaviors/zmk,behavior-bspc-special.yaml
```yaml
description: >
  Backspace special: tap = one Bspc, hold (cold or after a tap) = Bspc
  held down (OS repeat), tap-then-tap = Caps Word.

compatible: "zmk,behavior-bspc-special"

include: zero_param.yaml

properties:
  bindings:
    type: phandles
    required: true
    description: Single entry, the behavior invoked for the tap-then-tap case (Caps Word).
```

## config/dts/bindings/behaviors/zmk,behavior-chatter-guard.yaml
```yaml
description: Chatter-guard key behavior (passes hold/release straight through as HID down/up; drops a press+release pair that lands within CONFIG_ZMK_CHATTER_GUARD_MS of the previous release on the same position)

compatible: "zmk,behavior-chatter-guard"

include: one_param.yaml
```

## config/dts/bindings/behaviors/zmk,behavior-cleanse-alt.yaml
```yaml
description: Cleanse alternator - each physical press outputs LALT and F8 in alternation, one HID key per press, no waiting

compatible: "zmk,behavior-cleanse-alt"

include: zero_param.yaml
```

## config/dts/bindings/behaviors/zmk,behavior-debounce-tap.yaml
```yaml
description: Debounce-tap key behavior (single bounded pulse with a per-position cooldown)

compatible: "zmk,behavior-debounce-tap"

include: one_param.yaml
```

## config/dts/bindings/behaviors/zmk,behavior-g-anchor.yaml
```yaml
description: "G direction-anchored hold - press emits HID down immediately. A LEFT/RIGHT press seen while G is still physically held only sets a flag (G is not touched, direction proceeds with zero delay). On physical release, the eventual HID-up time is release_target = clamp(dir_press_relative_ms + DIR_TAIL_MS, MIN_TOTAL_HOLD_MS, MAX_TOTAL_HOLD_MS) measured from the physical press; if no direction has been seen yet, G waits up to MAX_TOTAL_HOLD_MS for one. No repeat/rapid-fire edges - one press, one (possibly delayed) release per physical session. Direction-key overlap with G is intentional, not avoided."

compatible: "zmk,behavior-g-anchor"

include: one_param.yaml
```

## config/dts/bindings/behaviors/zmk,behavior-g-burst.yaml
```yaml
description: "G burst - identical repeat behavior to plain rapid-fire (same interval/tap-width Kconfig, unchanged), except the repeat cycle auto-stops CONFIG_ZMK_G_BURST_MAX_MS after the physical press even if the key is still held. Physical release always stops the burst immediately, same as rapid-fire. Direction keys and other keys have no effect on this behavior in this first version."

compatible: "zmk,behavior-g-burst"

include: one_param.yaml
```

## config/dts/bindings/behaviors/zmk,behavior-g-latch.yaml
```yaml
description: G latch - press emits HID down immediately; physical release does NOT emit HID up, it latches until a direction key (glatch_direction) ends it or CONFIG_ZMK_G_LATCH_MAX_HOLD_MS (measured from physical press) is reached. No repeat/rapid-fire edges - one press, one (possibly delayed) release per physical session.

compatible: "zmk,behavior-g-latch"

include: one_param.yaml
```

## config/dts/bindings/behaviors/zmk,behavior-g-roll-grace.yaml
```yaml
description: G roll-aware grace - press emits HID down immediately. While physically held, a LEFT/RIGHT press is only noted (direction_seen), G stays down. On physical release, if a direction was already seen during the hold, HID up fires immediately (release_reason=direction_before_release). Otherwise a short grace window (CONFIG_ZMK_G_ROLL_GRACE_MS) starts: a direction press during grace ends it immediately (direction_after_release), otherwise the grace timing out ends it (timeout). No repeat/rapid-fire edges - one press, one (possibly grace-delayed) release per physical session.

compatible: "zmk,behavior-g-roll-grace"

include: one_param.yaml
```

## config/dts/bindings/behaviors/zmk,behavior-g-stretch.yaml
```yaml
description: Minimum-hold stretch - press emits HID down immediately; release emits HID up immediately if the physical hold already met the configured minimum, otherwise HID up is delayed until the minimum is reached. No repeat/rapid-fire edges - one press, one (possibly delayed) release per physical session.

compatible: "zmk,behavior-g-stretch"

include: one_param.yaml
```

## config/dts/bindings/behaviors/zmk,behavior-gaming-cmd-down.yaml
```yaml
description: Gaming command state machine - Down-arrow side. Every press outputs Down immediately, except the 3rd press within the command window, which outputs C instead (Command B).

compatible: "zmk,behavior-gaming-cmd-down"

include: zero_param.yaml
```

## config/dts/bindings/behaviors/zmk,behavior-gaming-cmd-trigger.yaml
```yaml
description: Gaming command state machine - trigger side. param1 = normal keycode sent when no command is pending, param2 = substitute keycode sent instead when the Down-arrow side has armed the command window (Command A).

compatible: "zmk,behavior-gaming-cmd-trigger"

include: two_param.yaml
```

## config/dts/bindings/behaviors/zmk,behavior-glatch-direction.yaml
```yaml
description: G latch direction-key wrapper - behaves exactly like &kp for its own keycode, but on press first ends an active G latch (HID G up) before emitting its own press, so G up always precedes the direction key's down. A no-op passthrough to plain &kp behavior when no latch is active.

compatible: "zmk,behavior-glatch-direction"

include: one_param.yaml
```

## config/dts/bindings/behaviors/zmk,behavior-groll-direction.yaml
```yaml
description: G roll-aware grace direction-key wrapper - behaves exactly like &kp for its own keycode. While G is held, marks direction_seen (G is not touched). While G is in its post-release grace window, ends the grace immediately (HID G up) before emitting its own press, so ordering is always G-up-then-direction-down. A no-op passthrough to plain &kp behavior otherwise.

compatible: "zmk,behavior-groll-direction"

include: one_param.yaml
```

## config/dts/bindings/behaviors/zmk,behavior-magic-shift.yaml
```yaml
description: >
  Magic Shift single-state-machine (OFF/PENDING/HELD), replacing zmk,behavior
  -hold-tap for this key so it never captures another key's raw position
  event. param1 is the modifier keycode (e.g. LSHFT), forwarded to
  bindings[0] (a &kp) for the hold path. bindings[1] is the short-tap
  behavior (a mod-morph reused unchanged, e.g. magic_shift_tap).

compatible: "zmk,behavior-magic-shift"

include: one_param.yaml

properties:
  bindings:
    type: phandles
    required: true
  tapping-term-ms:
    type: int
    default: 280
```

## config/dts/bindings/behaviors/zmk,behavior-rapid-fire.yaml
```yaml
description: Rapid-fire key behavior
compatible: "zmk,behavior-rapid-fire"
include: one_param.yaml
```

## config/dts/bindings/behaviors/zmk,behavior-smart-num.yaml
```yaml
description: >
  Smart Num single-state-machine (OFF/PENDING/MOMENTARY/STICKY). param1 is the
  NUM layer index. bindings[0] is the num-word (urob/zmk-auto-layer) behavior
  to delegate a plain short tap to; MOMENTARY and STICKY are managed directly
  by this behavior via zmk_keymap_layer_activate/deactivate.

compatible: "zmk,behavior-smart-num"

include: one_param.yaml

properties:
  bindings:
    type: phandles
    required: true
  tapping-term-ms:
    type: int
    default: 200
```

## config/dts/bindings/behaviors/zmk,behavior-space-holdtap.yaml
```yaml
description: Space hold-tap with chatter-tolerant tap debounce and hold release-grace

compatible: "zmk,behavior-space-holdtap"

include: two_param.yaml
```

## config/west.yml
```yaml
manifest:
  remotes:
    - name: zmkfirmware
      url-base: https://github.com/zmkfirmware
    - name: caksoylar
      url-base: https://github.com/caksoylar
    - name: unspecworks
      url-base: https://github.com/dh083064-ai
    - name: urob
      url-base: https://github.com/urob

  projects:
    - name: zmk
      remote: zmkfirmware
      revision: 641514a97db345f499dd50b0360e594270f008fe # main (2026-08-31), matches urob/zmk-config
      import: app/west.yml

    - name: zmk-rgbled-widget
      remote: caksoylar
      revision: main

    - name: zmk-keyboard-delta-omega
      remote: unspecworks
      revision: main

    # urob/zmk-config ports: SmartNum, Magic Shift, Smart Mouse, Swapper, Leader.
    - name: zmk-auto-layer
      remote: urob
      revision: 62c201934711369d50a28df12e1d055d05cb6460
    - name: zmk-tri-state
      remote: urob
      revision: 0c6eaf55d2da0d85b943e02d72831c2d8ea64501
    - name: zmk-leader-key
      remote: urob
      revision: e894d9afa5164b7fff641db4194fc3d4d6e84bbb
    - name: zmk-adaptive-key
      remote: urob
      revision: e5b335a7b1076cb122582f5a892b118b02a3be34

    # Matches the zmk commit above (v4.1.0+zmk-fixes); avoids the default zephyr checkout.
    - name: zephyr
      remote: zmkfirmware
      revision: 10ba6d0cb38bc3d258775d27982f707599320085
      clone-depth: 1
      import:
        name-allowlist:
          - cmsis
          - hal_nordic
          - hal_rpi_pico
          - hal_stm32
          - lvgl
          - mbedtls
          - tinycrypt

  self:
    path: config
```
